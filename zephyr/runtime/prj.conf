## CMakeLists.txt
```
# SPDX-License-Identifier: MPL-2.0

cmake_minimum_required(VERSION 3.20.0)

# Devicetree is generated before Kconfig is evaluated. Read the runtime
# default here so the Nordic HV setting also selects the matching TCXO voltage.
set(nordic_hv_regout0_3v3_config "")
foreach(conf_file "${CMAKE_CURRENT_SOURCE_DIR}/prj.conf" ${EXTRA_CONF_FILE})
    if(EXISTS "${conf_file}")
        file(STRINGS "${conf_file}"
            nordic_hv_regout0_3v3_config_file
            REGEX "^CONFIG_NORDIC_HV_REGOUT0_3V3=y$"
        )
        if(nordic_hv_regout0_3v3_config_file)
            list(APPEND nordic_hv_regout0_3v3_config
                ${nordic_hv_regout0_3v3_config_file}
            )
        endif()
    endif()
endforeach()
if(nordic_hv_regout0_3v3_config AND BOARD MATCHES "^(rak4631|.*nrf52840.*)")
    list(APPEND EXTRA_DTC_OVERLAY_FILE
        "${CMAKE_CURRENT_SOURCE_DIR}/dts/nordic_hv_regout0_3v3.overlay"
    )
endif()

list(APPEND DTS_ROOT
    "${CMAKE_CURRENT_SOURCE_DIR}/../modules/rtbus"
)

find_package(Zephyr REQUIRED HINTS $ENV{ZEPHYR_BASE})
project(rtbus_runtime)

add_subdirectory(../modules/rtbus rtbus)

target_sources(app PRIVATE
    src/main.c
    src/services/startup_service.c
    src/services/rtbus_serial.c
)

target_sources_ifdef(CONFIG_RTBUS_RUNTIME_BLE app PRIVATE
    src/services/rtbus_ble.c
)

target_sources_ifdef(CONFIG_NORDIC_HV_REGOUT0_3V3 app PRIVATE
    src/platform/nordic/nordic_hv_regout0_3v3.c
)

zephyr_include_directories(
    ${CMAKE_CURRENT_SOURCE_DIR}/../../system/framework/abi/include
    ${CMAKE_CURRENT_SOURCE_DIR}/../../system/framework/include
    include
)
```

## Kconfig
```
mainmenu "RTBus runtime configuration"

config NORDIC_HV_REGOUT0_3V3
	bool "Set Nordic HV REGOUT0 and SX1262 TCXO to 3.3 V"
	depends on SOC_NRF52840
	help
	  Program UICR REGOUT0 for a 3.3 V VDD and GPIO domain when the
	  nRF52840 is powered through VDDH, and configure the SX1262 DIO3
	  TCXO control voltage for 3.3 V. The device resets once after
	  changing UICR. Leave this disabled to preserve the existing
	  REGOUT0 setting and use the default TCXO voltage from the board runtime
	  overlay.

config RTBUS_NATIVE_API_TABLE_BASE
	hex "RTBus native application API table base address"
	default 0x2003FF00
	help
	  Fixed RAM address used by the runtime and native application payload to
	  exchange the RTBus native API table. Board profiles with smaller SRAM must
	  place this inside their reserved shared_ram devicetree node.

config RUNTIME_POOL_SIZE
	int "Runtime schedule parameter pool size"
	default 4096
	range 256 65536
	help
	  Static byte pool passed to schedule_init() for runtime event parameter
	  allocation. Small RAM targets can override this in their board
	  runtime.conf.

rsource "../modules/rtbus/Kconfig"

config RTBUS_RUNTIME_BLE
	bool "Enable RTBus runtime BLE service"
	depends on RTBUS_NATIVE_SERVICE
	depends on BT
	depends on BT_PERIPHERAL
	default y
	help
	  Enable the runtime-owned BLE task used by native applications and
	  Arduino sketches to start connectable BLE advertising and request
	  Just Works pairing or security changes through rtbus post.

source "Kconfig.zephyr"
```

## prj.conf
```kconfig
# SPDX-License-Identifier: MPL-2.0
### Direct-boot runtime baseline
CONFIG_BOOTLOADER_MCUBOOT=n
CONFIG_USE_DT_CODE_PARTITION=y
CONFIG_ROM_START_OFFSET=0
CONFIG_MAIN_STACK_SIZE=4096
CONFIG_SYSTEM_WORKQUEUE_STACK_SIZE=2048

### Runtime console / serial baseline
CONFIG_SERIAL=y
CONFIG_MULTITHREADING=y
CONFIG_EVENTS=y
CONFIG_UART_LINE_CTRL=y
CONFIG_UART_INTERRUPT_DRIVEN=y
CONFIG_UART_USE_RUNTIME_CONFIGURE=y
CONFIG_CONSOLE=y
CONFIG_UART_CONSOLE=y
CONFIG_LOG=y
CONFIG_LOG_BACKEND_SHOW_COLOR=n
CONFIG_LOG_BACKEND_UART=y
CONFIG_LOG_BACKEND_UART_ASYNC=n
CONFIG_LOG_BACKEND_UART_BUFFER_SIZE=256
CONFIG_USE_SEGGER_RTT=n

# Runtime Serial.printf(), RTT printk, and logging support floating-point formats.
CONFIG_CBPRINTF_FP_SUPPORT=y

### Application component slot
CONFIG_FLASH=y
CONFIG_FLASH_PAGE_LAYOUT=y
CONFIG_FLASH_MAP=y
CONFIG_STREAM_FLASH=y
CONFIG_REBOOT=y

### RTBus baseline modules
CONFIG_RTBUS_LIB=y
CONFIG_RTBUS_NATIVE_SERVICE=y
CONFIG_RTBUS_IMAGE_RAM_MAX=8192
CONFIG_RUNTIME_POOL_SIZE=4096

### Downstream transports/features are provided by optional modules and overlays.
CONFIG_BT=n

CONFIG_BUILD_OUTPUT_META=y
```

## app-p256.conf
```kconfig
# SPDX-License-Identifier: MPL-2.0
# Merge with the selected board configuration. Configure PSA independently of
# RTBus service dependencies to avoid reverse-select Kconfig cycles.
CONFIG_PSA_CRYPTO=y
CONFIG_PSA_WANT_ALG_SHA_256=y
CONFIG_PSA_WANT_ALG_ECDSA=y
CONFIG_PSA_WANT_KEY_TYPE_ECC_PUBLIC_KEY=y
CONFIG_PSA_WANT_ECC_SECP_R1_256=y
CONFIG_RTBUS_IMAGE_VERIFY_P256=y

# Initial ECDSA workspace budget, separate from application/system heap.
CONFIG_MBEDTLS_ENABLE_HEAP=y
CONFIG_MBEDTLS_HEAP_SIZE=8192
CONFIG_MBEDTLS_PSA_KEY_SLOT_COUNT=2
CONFIG_SYSTEM_WORKQUEUE_STACK_SIZE=4096
```

## dts/nordic_hv_regout0_3v3.overlay
```dts
/* SPDX-License-Identifier: MPL-2.0 */
#include <zephyr/dt-bindings/lora/sx126x.h>

&lora {
	dio3-tcxo-voltage = <SX126X_DIO3_TCXO_3V3>;
};
```

## src/main.c
```c
/* SPDX-License-Identifier: MPL-2.0 */
int main(void)
{
    return 0;
}
```
