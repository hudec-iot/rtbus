## cores/stm32l071/zephyr/boards/others/stm32l071/Kconfig.stm32l071
```kconfig
# SPDX-License-Identifier: MPL-2.0

config BOARD_STM32L071
	select SOC_STM32L071XX
```

## cores/stm32l071/zephyr/boards/others/stm32l071/board.yml
```yaml
# SPDX-License-Identifier: MPL-2.0
board:
  name: stm32l071
  full_name: STM32L071
  vendor: others
  socs:
    - name: stm32l071xx
```

## zephyr/modules/rtbus/dts/bindings/rtbus,native-adc.yaml
```yaml
# SPDX-License-Identifier: MPL-2.0
description: RTBus native application single-ended ADC export map
compatible: "rtbus,native-adc"
child-binding:
  description: ADC input exported to native applications
  properties:
    rtbus,pin:
      type: int
      required: true
    io-channels:
      type: phandle-array
      required: true
    gpios:
      type: phandle-array
      required: true
      description: Pin to disconnect from digital GPIO before ADC sampling.
```
