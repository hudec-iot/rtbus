## cores/rak4200/zephyr/boards/rakwireless/rak4200/board.yml
```yaml
# SPDX-License-Identifier: MPL-2.0
board:
  name: rak4200
  full_name: RAK4200
  vendor: rakwireless
  socs:
    - name: stm32l071xx
```
